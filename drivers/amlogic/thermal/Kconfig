## drivers/amlogic/thermal/Kconfig
```kconfig
# Amlogic Thermal


config AML_VIRTUAL_THERMAL
    bool "Amlogic virtual thermal interface"
    default n
    help 
        Say Y if you want use amlogic virtual thermal interface

config AML_PLATFORM_THERMAL 
    bool "Amlogic platform thermal interface"
    default n
    help 
        Say Y if you want use amlogic platform thermal interface

config AMLOGIC_THERMAL
    tristate "amlogic thermal support"
    select THERMAL
    select CPU_THERMAL
    select GPU_THERMAL
    select CPUCORE_THERMAL
    select GPUCORE_THERMAL
    select AML_VIRTUAL_THERMAL 
    select AML_PLATFORM_THERMAL
    depends on CPU_FREQ
    default n
    help
      This is the Amlogic Thermal interface driver
```

## drivers/amlogic/wifi/Kconfig
```kconfig
comment "Amlogic Wifi Driver"

menuconfig AM_WIFI
	boolean "WiFi support"
	default n
	help
		select y to support wifi

if AM_WIFI
config AM_WIFI_SD_MMC
	boolean "Amlogic SDIO Wi-Fi support"
	depends on AM_WIFI
	default n

config AM_WIFI_USB
        boolean "Amlogic USB Wi-Fi Dongle Support"
        depends on AM_WIFI
        default n

config DHD_USE_STATIC_BUF
	boolean "broadcom wifi static buff support"
	depends on AM_WIFI
	default n

source "drivers/amlogic/wifi/rtl8189ES/Kconfig"
source "drivers/amlogic/wifi/rtl8192EU/Kconfig"
source "drivers/amlogic/wifi/rtl8723AU/Kconfig"
source "drivers/amlogic/wifi/rtl8723BS/Kconfig"
source "drivers/amlogic/wifi/rtl8811AU/Kconfig"
source "drivers/amlogic/wifi/rtl8812AU/Kconfig"
source "drivers/amlogic/wifi/rtl8xxx_CU/Kconfig"
source "drivers/amlogic/wifi/rtl8xxx_DU/Kconfig"
source "drivers/amlogic/wifi/rtl8xxx_EU/Kconfig"
source "drivers/amlogic/wifi/bcmdhd/Kconfig"

endif # AM_WIFI
```
